/dts-v1/;
/plugin/;

&spi1 {
    status = "okay";
    #address-cells = <1>;
    #size-cells = <0>;

    imu_sensor: imu@0 {
        compatible = "invensense,mpu9250"; /* example */
        reg = <0>;
        spi-max-frequency = <10000000>;
        spi-cpha;
        spi-cpol;
        interrupt-parent = <&gpio>;
        interrupts = <123 IRQ_TYPE_EDGE_RISING>;
    };
};
